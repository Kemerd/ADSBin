## main/Kconfig.projbuild
```kconfig
menu "ADSBin"

    config ADSBIN_STATUS_LED_GPIO
        int "Status LED GPIO (-1 to disable)"
        default -1
        help
            GPIO driving the Phase-0 heartbeat LED. The right pin differs across
            ESP32-P4 dev boards, so there is intentionally NO board default --
            set this to your board's user LED. Leave it at -1 and the firmware
            still proves life via the console heartbeat (no LED needed).

    config ADSBIN_STATUS_LED_ACTIVE_LOW
        bool "Status LED is active-low"
        default n
        help
            Enable if the LED lights when the GPIO is driven LOW.

    config ADSBIN_AP_SSID
        string "WiFi SoftAP SSID (ForeFlight link)"
        default "ADSBin"
        help
            Name of the OPEN (no-password) WiFi network the on-board ESP32-C6
            broadcasts. A tablet running ForeFlight joins this network and
            receives GDL90 traffic over UDP :4000. Hard-set here per board.

    config ADSBIN_AP_CHANNEL
        int "WiFi SoftAP channel"
        default 6
        range 1 13
        help
            2.4 GHz channel the SoftAP runs on. 1/6/11 are the non-overlapping
            choices; 6 is a safe default.

    config ADSBIN_AP_MAX_CLIENTS
        int "WiFi SoftAP max simultaneous clients"
        default 4
        range 1 8
        help
            How many devices may associate at once. Keep small: the link exists
            to feed one or two tablets, not to be a general hotspot.

    # ─────────────────────────────────────────────────────────────────────────
    #  GPS (u-blox MAX-M10S) — OPTIONAL live ownship position + clock discipline
    #
    #  The whole GPS feature is gated on ADSBIN_GPS_UART_RX_GPIO: leave it at -1
    #  (the default) and an un-wired board compiles and runs EXACTLY as today —
    #  no GPS task, no UART installed, GDL90 ownship stays silent. Pins follow the
    #  same "-1 disables" idiom as ADSBIN_STATUS_LED_GPIO. Defaults target free,
    #  non-strapping GPIOs on the Waveshare ESP32-P4-WIFI6 (clear of the UART0
    #  console, the C6 SDIO block GPIO14-19+54, and I2C GPIO7/8); verify against
    #  your board's header before wiring and change them here if your pinout
    #  differs — no code change is needed, only these defaults.
    # ─────────────────────────────────────────────────────────────────────────
    config ADSBIN_GPS_UART_RX_GPIO
        int "GPS UART RX GPIO  (P4 RX <- module TX; -1 disables GPS entirely)"
        default 20
        help
            P4 GPIO wired to the MAX-M10S TX pin (NMEA in). This is the PRIMARY
            enable gate for the whole GPS feature: set it to -1 and the firmware
            never installs the GPS UART, never parses NMEA, and never publishes an
            ownship fix — the box behaves bit-for-bit as if GPS did not exist.
            This is the ONLY wire strictly required for a live ownship position.

    config ADSBIN_GPS_UART_TX_GPIO
        int "GPS UART TX GPIO  (P4 TX -> module RX, UBX config; -1 = no config wire)"
        default 21
        help
            P4 GPIO wired to the MAX-M10S RX pin. Used once at boot to send a
            UBX-CFG-VALSET burst (enable the 1PPS timepulse, set a 1 Hz nav rate,
            trim NMEA to GGA+RMC). Set to -1 to skip the config burst entirely; the
            module then runs at its 9600 baud / 1 Hz factory defaults and ownship
            still works — only the optional timepulse tuning is skipped.

    config ADSBIN_GPS_PPS_GPIO
        int "GPS PPS GPIO  (P4 <- module TIMEPULSE; -1 disables PPS discipline)"
        default 22
        help
            P4 GPIO wired to the MAX-M10S TIMEPULSE (1PPS) pin. Drives the
            hardware-captured clock-discipline layer (GPTimer + ETM + PCNT, zero
            load on the Core-0 DSP path). Set to -1 to disable PPS: the clock ladder
            then tops out at NMEA-fix timing, with no other effect. Must be an
            ETM-capable GPIO.

    config ADSBIN_GPS_UART_NUM
        int "GPS UART controller number"
        default 1
        range 1 5
        help
            Which P4 UART controller serves the GPS. MUST NOT be the console UART
            (UART0 carries the GDL90/debug output and the +INJECT reader). Defaults
            to UART1, which is verified free in this firmware.

    config ADSBIN_GPS_BAUD
        int "GPS UART baud rate"
        default 9600
        help
            Initial NMEA baud for the GPS UART. 9600 is the MAX-M10S factory
            default and is used to configure the port before any UBX retune.

endmenu
```

## sdkconfig.defaults
```kconfig
# ============================================================================
#  ADSBin - default sdkconfig (seeds a fresh build; the real sdkconfig is
#  generated and git-ignored). Phase 0 scaffold scope: target, console, dual
#  core, custom partitions. USB-host tuning lands in Phase 1; WiFi/C6 Phase 10.
# ============================================================================

# --- Target -----------------------------------------------------------------
# ESP32-P4: dual-core RISC-V, USB 2.0 High-Speed OTG host. The HS host is the
# whole reason for this part - 2.4 Msps x 2 bytes ~= 4.8 MB/s of IQ is far past
# what a Full-Speed S3 could carry (IMPLEMENTATION_PLAN.md S5.1).
CONFIG_IDF_TARGET="esp32p4"

# --- Silicon revision -------------------------------------------------------
# Our physical dev board carries an EARLY P4 sample (rev v1.3). ESP-IDF v6
# defaults the P4 to the mass-production v3.x family, but rev <3.0 and >=3.0 are
# a "mutually exclusive" hardware split (see esp_hw_support P4 Kconfig): a v3.x
# image refuses to boot/flash on v1.x silicon. Opt into the pre-v3 family and
# set the minimum supported revision to v1.0 so this v1.3 chip is in range.
CONFIG_ESP32P4_SELECTS_REV_LESS_V3=y
CONFIG_ESP32P4_REV_MIN_100=y

# --- Console / logging ------------------------------------------------------
# The P4's USB-C port is power + debug, carrying console/monitor AND the MVP
# GDL90 / sink_debug stream (S1.1, S4.5). The transport chip depends on the
# board, though: THIS dev board routes its single USB-C jack through an on-board
# CH343 USB-UART bridge wired to the P4's default download UART (UART0) — the
# native USB-Serial/JTAG controller has no connector. So the console must be on
# UART0, not USB-Serial/JTAG, or nothing reaches the host (and the bench can't
# feed packets in). UART0's pre-defined GPIOs are the same pins esptool flashes
# over, which is why flashing works on this board. Boards that break out the
# native USB-C port can switch this back to CONFIG_ESP_CONSOLE_USB_SERIAL_JTAG.
CONFIG_ESP_CONSOLE_UART_DEFAULT=y

# --- FreeRTOS / SMP ---------------------------------------------------------
# Keep BOTH cores online. Core 0 is the hard-real-time RX+DSP path, Core 1 is
# decode + serve (S2). Never enable UNICORE. 1 kHz tick gives 1 ms aging math.
# CONFIG_FREERTOS_UNICORE is not set
CONFIG_FREERTOS_HZ=1000

# --- Flash / partitions -----------------------------------------------------
# 16 MB assumed (typical P4 dev board). If your board differs, change this one
# line; the partition layout fits in 8 MB too. Two OTA app slots leave room for
# field firmware updates without a serial cable later.
CONFIG_ESPTOOLPY_FLASHSIZE_16MB=y
CONFIG_PARTITION_TABLE_CUSTOM=y
CONFIG_PARTITION_TABLE_CUSTOM_FILENAME="partitions.csv"

# --- Logging verbosity (bring-up) ------------------------------------------
CONFIG_LOG_DEFAULT_LEVEL_INFO=y
CONFIG_LOG_MAXIMUM_LEVEL_DEBUG=y

# --- WiFi via on-board ESP32-C6 (esp-hosted) -------------------------------
# The P4 has no radio; it reaches WiFi through the on-board C6 over SDIO. The
# esp_wifi_remote managed component (pulled by main/idf_component.yml) re-exports
# the standard esp_wifi.h API and RPCs it to the C6. Select its HOSTED backend
# (the esp-hosted SDIO transport) rather than the EPPP/UART one. This symbol is
# stable across versions; still verify it survives reconfigure:
CONFIG_ESP_WIFI_REMOTE_LIBRARY_HOSTED=y
#
# Slave target = ESP32-C6. RESOLVED (verified after reconfigure 2026-06-09): the
# esp_hosted Kconfig defaults already select the C6 once HOSTED is enabled above
# — sdkconfig resolves CONFIG_ESP_HOSTED_CP_TARGET_ESP32C6=y on its own, so we do
# NOT pin it here (kconfgen silently drops an unknown CONFIG_ name, so an active
# wrong guess is worse than relying on the confirmed default). The real symbol is
# CONFIG_ESP_HOSTED_CP_TARGET_ESP32C6 (gated by SLAVE_IDF_TARGET_ESP32C6); the
# other two candidates below were WRONG names. Left documented, not active:
# CONFIG_SLAVE_IDF_TARGET_ESP32C6=y          (a dependency symbol, auto-set)
# CONFIG_ESP_HOSTED_TARGET_ESP32C6=y         (WRONG: no such symbol)
# CONFIG_ESP_HOSTED_CP_TARGET_ESP32C6=y      (REAL name; auto-resolves, no need to pin)
#
# SDIO PIN MAP: the C6<->P4 SDIO pins are board-specific and ALSO live in the
# esp_hosted Kconfig. The Waveshare ESP32-P4-WIFI6 pinout may differ from the
# Espressif Function-EV reference (CLK=18,CMD=19,D0=14,D1=15,D2=16,D3=17,
# reset=GPIO54). VERIFY against the Waveshare schematic after reconfigure and
# add the board's CONFIG_ESP_HOSTED_SDIO_* overrides here if they differ.
# (Confirmed 2026-06-09: the SDIO link comes up on the Waveshare with the stock
# defaults - "H_SDIO_DRV: sdio_data_to_rx_buf_task started" at boot.)

# --- External PSRAM (on-package 32 MB) -------------------------------------
# REQUIRED ONCE WIFI IS LINKED. The esp_hosted + esp_wifi_remote + lwip stack
# reserves a large slab of INTERNAL SRAM at startup; without PSRAM that starved
# demod1090's 128 KB magnitude LUT (MALLOC_CAP_INTERNAL) and the box boot-looped
# on ESP_ERR_NO_MEM. Turning on the package PSRAM and steering the WiFi/lwIP
# buffers into it frees the internal SRAM back up so the hot-path LUT still lives
# in fast internal RAM (we deliberately DON'T move the LUT to slower PSRAM - it is
# hit per IQ sample on the Core-0 DSP path).
CONFIG_SPIRAM=y
# HEX (16-line) PSRAM is the only mode the P4 package supports; 200 MHz is the
# default and the fastest available on our rev <3 silicon (250 MHz is gated to
# rev >=3 by Kconfig, and we run rev v1.3 - see ESP32P4_SELECTS_REV_LESS_V3).
CONFIG_SPIRAM_MODE_HEX=y
CONFIG_SPIRAM_SPEED_200M=y
# Let the heap allocator hand out PSRAM, and prefer it for the big WiFi/lwIP
# buffers specifically - this is the targeted relief for the SRAM pressure above.
CONFIG_SPIRAM_USE_MALLOC=y
CONFIG_SPIRAM_TRY_ALLOCATE_WIFI_LWIP=y
```
